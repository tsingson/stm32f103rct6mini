## boards/seeed/beetle_esp32c6/Kconfig.beetle_esp32c6
```kconfig
# Beetle ESP32-C6 board configuration

# SPDX-License-Identifier: Apache-2.0

config BOARD_BEETLE_ESP32C6
	select SOC_ESP32_C6_WROOM_1U_N4
	select SOC_ESP32C6_HPCORE
```

## boards/seeed/beetle_esp32c6/board.yml
```yaml
board:
  name: beetle_esp32c6
  full_name: Beetle ESP32-C6
  vendor: seeed
  socs:
  - name: esp32c6
```
